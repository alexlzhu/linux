## drivers/misc/nnpi/Kconfig
```kconfig
config SPH
        tristate "Driver for Intel SPH"
        help
          Driver for Intel SPH

config SPH_ULT
	def_bool n
        depends on SPH

config  SPH_HW_LAYER_SPH
        def_bool y
        depends on SPH
```

## drivers/platform/Kconfig
```kconfig
# SPDX-License-Identifier: GPL-2.0-only
if X86
source "drivers/platform/x86/Kconfig"
endif
if MIPS
source "drivers/platform/mips/Kconfig"
endif

source "drivers/platform/goldfish/Kconfig"

source "drivers/platform/chrome/Kconfig"

source "drivers/platform/mellanox/Kconfig"

source "drivers/platform/olpc/Kconfig"

source "drivers/platform/surface/Kconfig"

config FACEBOOK_EXTRA_DEPS
       def_bool y
       select DMA_SHARED_BUFFER
       select FRAME_VECTOR
       help
         Select a few options we lack because we keep drivers off, but we
         still want in our kernel for some experimental out-of-tree drivers.
```

## net/Kconfig.debug
```kconfig
# SPDX-License-Identifier: GPL-2.0-only

config DEBUG_NET
	bool "Add generic networking debug"
	depends on DEBUG_KERNEL
	help
	  Enable extra sanity checks in networking.
	  This is mostly used by fuzzers, but is safe to select.
```

## net/netlink/Kconfig
```kconfig
# SPDX-License-Identifier: GPL-2.0-only
#
# Netlink Sockets
#

config NETLINK_DIAG
	tristate "NETLINK: socket monitoring interface"
	default n
	help
	  Support for NETLINK socket monitoring interface used by the ss tool.
	  If unsure, say Y.

config NETLINK_DEBUG_RINGBUFFER_SIZE
	int "NETLINK: ring buffer size in bytes for storing incoming requests"
	default 0
	help
	  If non-zero, a ring buffer of given size in bytes will be used to store
	  incoming netlink requests. Also stores netdevice requests via ioctl.
	  If unsure, use 0.
```
